## PetaLinux 2024.2 Audio/petalinux2024_2-project-spec_doom_audio_20250207/configs/rootfsconfigs/Kconfig.user
```kconfig
menu "user packages " 
config clk-dglnt-dynclk  
	 bool "clk-dglnt-dynclk"
	 help
	
config cs4344  
	 bool "cs4344"
	 help
	
config digilent-hdmi  
	 bool "digilent-hdmi"
	 help
	
config doom  
	 bool "doom"
	 help
	
config fbtest  
	 bool "fbtest"
	 help
	
config flash-led  
	 bool "flash-led"
	 help
	
config gpio-demo  
	 bool "gpio-demo"
	 help
	
config peekpoke  
	 bool "peekpoke"
	 help
	
config rehsdmisc  
	 bool "rehsdmisc"
	 help
	
config sndserver  
	 bool "sndserver"
	 help
	
config spidev-test  
	 bool "spidev-test"
	 help
	
config wm8960-snddrv  
	 bool "wm8960-snddrv"
	 help
	
endmenu
```

## PetaLinux 2024.2 Audio/petalinux2024_2-project-spec_doom_audio_20250207/meta-mylayer/conf/layer.conf
```bitbake
IMAGE_INSTALL:append = " imagemagick"
IMAGE_INSTALL:append = " libsdl2"
#IMAGE_INSTALL:append = " misc"
IMAGE_INSTALL:append = " nano"
IMAGE_INSTALL:append = " gpm"
IMAGE_INSTALL:append = " libasan"
```

## PetaLinux 2024.2 HDMI/Vivado and PetaLinux - 20250418/PetaLinux/project-spec/configs/rootfsconfigs/Kconfig.user
```kconfig
menu "user packages " 
config libsdl2  
	 bool "libsdl2"
	 help
	
config clk-dglnt-dynclk  
	 bool "clk-dglnt-dynclk"
	 help
	
config clk-dglnt-dynclk2  
	 bool "clk-dglnt-dynclk2"
	 help
	
config cs4344  
	 bool "cs4344"
	 help
	
config digilent-hdmi  
	 bool "digilent-hdmi"
	 help
	
config digilent-hdmi2  
	 bool "digilent-hdmi2"
	 help
	
config doom  
	 bool "doom"
	 help
	
config fbtest  
	 bool "fbtest"
	 help
	
config flash-led  
	 bool "flash-led"
	 help
	
config gpm  
	 bool "gpm"
	 help
	
config imagemagick  
	 bool "imagemagick"
	 help
	
config nano  
	 bool "nano"
	 help
	
config pcmanfm  
	 bool "pcmanfm"
	 help
	
config rehsd-hdmi  
	 bool "rehsd-hdmi"
	 help
	
config rehsd-hdmi2  
	 bool "rehsd-hdmi2"
	 help
	
config rehsd-vga  
	 bool "rehsd-vga"
	 help
	
config rehsdmisc  
	 bool "rehsdmisc"
	 help
	
config sndserver  
	 bool "sndserver"
	 help
	
config spidev-test  
	 bool "spidev-test"
	 help
	
config sysbench  
	 bool "sysbench"
	 help
	
config vlc  
	 bool "vlc"
	 help
	
config wayland  
	 bool "wayland"
	 help
	
config wayland-protocols  
	 bool "wayland-protocols"
	 help
	
config wayland-utils  
	 bool "wayland-utils"
	 help
	
config weston  
	 bool "weston"
	 help
	
config weston-init  
	 bool "weston-init"
	 help
	
config wm8960-snddrv  
	 bool "wm8960-snddrv"
	 help
	
endmenu
```

## PetaLinux 2024.2 HDMI/Vivado and PetaLinux - 20250418/PetaLinux/project-spec/meta-mylayer/conf/layer.conf
```bitbake
# IMAGE_INSTALL:append = " imagemagick"
# IMAGE_INSTALL:append = " libsdl2"
# IMAGE_INSTALL:append = " nano"
# IMAGE_INSTALL:append = " gpm"
# IMAGE_INSTALL:append = " libasan"


# We have a conf and classes directory, add to BBPATH
BBPATH .= ":${LAYERDIR}"

# We have recipes-* directories, add to BBFILES
BBFILES += "${LAYERDIR}/recipes-*/*/*.bb \
            ${LAYERDIR}/recipes-*/*/*.bbappend"

BBFILE_PATTERN_meta-user = "^${LAYERDIR}/"
BBFILE_PRIORITY_meta-user = "10"
LAYERSERIES_COMPAT_meta-user = "scarthgap dunfell warrior zeus gatesgarth hardknott honister kirkstone langdale mickledore"
```

## PetaLinux 2024.2 HDMI/project-spec 20241230/configs/configs/Kconfig
```kconfig
mainmenu "PetaLinux System Configuration"
config SUBSYSTEM_TYPE_LINUX
        bool
        default y
        select SYSTEM_ZYNQ

config SYSTEM_ZYNQ
        bool "ZYNQ Configuration"
        help
          ZYNQ Configuration for petalinux project.
          All these config options will be in /home/rich/petalinux20242/rehsdZynq/project-spec/configs/config

config SUBSYSTEM_DISTRO_PETALINUX
        bool
        default y
        help

source /home/rich/petalinux20242/rehsdZynq/project-spec/configs/configs/Kconfig.main
```

## PetaLinux 2024.2 HDMI/project-spec 20250109/configs/rootfsconfigs/Kconfig.user
```kconfig
menu "user packages " 
config clk-dglnt-dynclk  
	 bool "clk-dglnt-dynclk"
	 help
	
config digilent-hdmi  
	 bool "digilent-hdmi"
	 help
	
config doom  
	 bool "doom"
	 help
	
config fbtest  
	 bool "fbtest"
	 help
	
config flash-led  
	 bool "flash-led"
	 help
	
config gpio-demo  
	 bool "gpio-demo"
	 help
	
config peekpoke  
	 bool "peekpoke"
	 help
	
config rehsdmisc  
	 bool "rehsdmisc"
	 help
	
endmenu
```

## PetaLinux 2024.2 HDMI/project-spec 20250215/configs/rootfsconfigs/Kconfig.user
```kconfig
menu "user packages " 
config libsdl2  
	 bool "libsdl2"
	 help
	
config clk-dglnt-dynclk  
	 bool "clk-dglnt-dynclk"
	 help
	
config cs4344  
	 bool "cs4344"
	 help
	
config digilent-hdmi  
	 bool "digilent-hdmi"
	 help
	
config doom  
	 bool "doom"
	 help
	
config fbtest  
	 bool "fbtest"
	 help
	
config flash-led  
	 bool "flash-led"
	 help
	
config gpm  
	 bool "gpm"
	 help
	
config imagemagick  
	 bool "imagemagick"
	 help
	
config nano  
	 bool "nano"
	 help
	
config rehsdmisc  
	 bool "rehsdmisc"
	 help
	
config sndserver  
	 bool "sndserver"
	 help
	
config spidev-test  
	 bool "spidev-test"
	 help
	
config wayland  
	 bool "wayland"
	 help
	
config wayland-protocols  
	 bool "wayland-protocols"
	 help
	
config wayland-utils  
	 bool "wayland-utils"
	 help
	
config weston  
	 bool "weston"
	 help
	
config weston-init  
	 bool "weston-init"
	 help
	
config wm8960-snddrv  
	 bool "wm8960-snddrv"
	 help
	
endmenu
```

## PetaLinux 2024.2 HDMI/project-spec 20250215/meta-user/conf/local.conf
```bitbake
BBLAYERS += "${TOPDIR}/project-spec/meta-mylayer
BBLAYERS += "${TOPDIR}/project-spec/meta-mylayer2
```
